/*
 * Copyright (C) 2015 Víctor Mayoral Vilches <victor@erlerobot.com>
 *
 * This program is free software; you can redistribute it and/or modify
 * it under the terms of the GNU General Public License version 2 as
 * published by the Free Software Foundation.
 */

&spi1 {
	pinctrl-names = "default";

	status = "okay";
};
