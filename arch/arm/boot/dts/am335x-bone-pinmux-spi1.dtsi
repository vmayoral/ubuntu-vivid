/*
 * Copyright (C) 2015 Erle Robotics
 *		Modified by Víctor Mayoral Vilches from Mirko Denecke and Siddharth Purohit work
 *
 * This program is free software; you can redistribute it and/or modify
 * it under the terms of the GNU General Public License version 2 as
 * published by the Free Software Foundation.
 */

#include <dt-bindings/board/am335x-bbw-bbb-base.h>
#include "am335x-peripheral-spi1.dtsi"

&am33xx_pinmux {
	spi1_pins: pinmux_spi1_pins {
		pinctrl-single,pins = <
                                0x190 0x33      /* mcasp0_aclkx.spi1_sclk, SPI1_SCLK P9_31 */
                                0x194 0x13      /* mcasp0_fsx.spi1_d0, SPI1_MOSI P9_29 */
                                0x198 0x33      /* mcasp0_axr0.spi1_d1, SPI1_MISO P9_30 */
                                /* setup a dummy CS for the SPI driver to use, then
                                   setup pin modes for the four real CS lines to
                                   set them pull-up */
                                0x058 0x07      /* dummy CS */
				0x164 0x37      /* P9_42 MS5611 CS */
				0x19C 0x37      /* P9_28 MPU6000 CS */
				0x044 0x37      /* P9_23 MPU9250 CS */
				0x030 0x37      /* P8_12 FRAM CS */
		>;
	};
};

&spi1 {
	pinctrl-0 = <&spi1_pins>;

	spi1_0 {
		#address-cells = <1>;
		#size-cells = <0>;
		spi-max-frequency = <24000000>;
		reg = <0>;
		compatible = "spidev";
	};
};
