/*
 * Copyright (C) 2015 Erle Robotics 
 *              Mayoral Vilches <victor@erlerobot.com>
 *
 * This program is free software; you can redistribute it and/or modify
 * it under the terms of the GNU General Public License version 2 as
 * published by the Free Software Foundation.
 */

/* Pins conflict with i2c2 */
/* #include "am335x-peripheral-can0.dtsi" */
/* #include "am335x-bone-pinmux-can0.dtsi" */

/* CAN1 */
#include "am335x-peripheral-can1.dtsi"
#include "am335x-bone-pinmux-can1.dtsi"

/* Pins conflict with can0 */
/* I2C 2 */
#include "am335x-peripheral-i2c2.dtsi"
#include "am335x-bone-pinmux-i2c2.dtsi"
#include "am335x-cape-i2c2-eeprom.dtsi"

/* I2C 1 
#include "am335x-peripheral-i2c1.dtsi"
#include "am335x-bone-pinmux-i2c1.dtsi"
*/

/* eMMC */
#include "am335x-peripheral-emmc.dtsi"
#include "am335x-bone-pinmux-emmc.dtsi"

/* SPI 0 */
#include "am335x-peripheral-spi0.dtsi"
#include "am335x-bone-pinmux-spi0.dtsi"

/* SPI 1 */
#include "am335x-peripheral-spi1.dtsi"
#include "am335x-bone-pinmux-spi1.dtsi"
 
/* TTYO4 */
#include "am335x-peripheral-ttyS4.dtsi"
#include "am335x-bone-pinmux-ttyS4.dtsi"

/* TTYO5 */
#include "am335x-peripheral-ttyS5.dtsi"
#include "am335x-bone-pinmux-ttyS5.dtsi"

/* eHRPWM */
#include "am33xx-ehrpwm.dtsi"
#include "bone_pwm_P8_36-00A0.dtsi"

/* ADC */
#include "bb-adc.dtsi"

&am33xx_pinmux {
	pru_pins: pinmux_pru_pins {
		pinctrl-single,pins = <
					0x03c 0x2E	/* gpmc_ad13.pr1_pru0_pru_r30_15, MODE6 | INPUT | PRU, PPM-sum, SBUS, DSM */

					0x0e0 0x25	/* lcd_vsync.pr1_pru1_pru_r30_8, MODE5 | OUTPUT | PRU, CH_2 */
					0x0e8 0x25	/* lcd_pclk.pr1_pru1_pru_r30_10, MODE5 | OUTPUT | PRU, CH_1 */
					0x0e4 0x25	/* lcd_hsync.pr1_pru1_pru_r30_9, MODE5 | OUTPUT | PRU, CH_4 */
					0x0ec 0x25	/* lcd_ac_bias_en.pr1_pru1_pru_r30_11, MODE5 | OUTPUT | PRU, CH_3 */
					0x0b8 0x25	/* lcd_data6.pr1_pru1_pru_r30_6, MODE5 | OUTPUT | PRU, CH_6 */
					0x0bc 0x25	/* lcd_data7.pr1_pru1_pru_r30_7, MODE5 | OUTPUT | PRU, CH_5 */
					0x0b0 0x25	/* lcd_data4.pr1_pru1_pru_r30_4, MODE5 | OUTPUT | PRU, CH_8 */
					0x0b4 0x25	/* lcd_data5.pr1_pru1_pru_r30_5, MODE5 | OUTPUT | PRU, CH_7 */
					0x0a8 0x25	/* lcd_data2.pr1_pru1_pru_r30_2, MODE5 | OUTPUT | PRU, CH_10 */
					0x0ac 0x25	/* lcd_data3.pr1_pru1_pru_r30_3, MODE5 | OUTPUT | PRU, CH_9 */
					0x0a0 0x25	/* lcd_data0.pr1_pru1_pru_r30_0, MODE5 | OUTPUT | PRU, CH_12 */
					0x0a4 0x25	/* lcd_data1.pr1_pru1_pru_r30_1, MODE5 | OUTPUT | PRU, CH_11 */
		>;
	};
};

&pruss {
	pinctrl-names = "default";
	pinctrl-0 = <&pru_pins>;
	status = "okay";
};
